/* ENDING.BIN: accepted SDK catalog aliases with archive prototypes.
 * PROVIDE preserves existing authored labels; this does not split assembly.
 */
PROVIDE(DecDCTReset = 0x800622D4);
PROVIDE(DecDCTGetEnv = 0x8006230C);
PROVIDE(DecDCTPutEnv = 0x80062398);
PROVIDE(DecDCTBufSize = 0x80062434);
PROVIDE(DecDCTin = 0x80062440);
PROVIDE(DecDCTout = 0x800624BC);
PROVIDE(DecDCTinSync = 0x800624DC);
PROVIDE(DecDCToutSync = 0x80062518);
PROVIDE(DecDCTinCallback = 0x80062554);
PROVIDE(DecDCToutCallback = 0x80062578);
PROVIDE(DecDCTvlcSize2 = 0x80062A38);
PROVIDE(DecDCTvlc2 = 0x80062A68);
PROVIDE(DecDCTvlcBuild = 0x80062DC8);
