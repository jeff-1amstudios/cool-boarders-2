/* MODE_SEL.BIN: accepted SDK catalog aliases with archive prototypes.
 * PROVIDE preserves existing authored labels; this does not split assembly.
 */
PROVIDE(DecDCTReset = 0x8006EFA4);
PROVIDE(DecDCTGetEnv = 0x8006EFDC);
PROVIDE(DecDCTPutEnv = 0x8006F068);
PROVIDE(DecDCTBufSize = 0x8006F104);
PROVIDE(DecDCTin = 0x8006F110);
PROVIDE(DecDCTout = 0x8006F18C);
PROVIDE(DecDCTinSync = 0x8006F1AC);
PROVIDE(DecDCToutSync = 0x8006F1E8);
PROVIDE(DecDCTinCallback = 0x8006F224);
PROVIDE(DecDCToutCallback = 0x8006F248);
PROVIDE(DecDCTvlcSize2 = 0x8006F708);
PROVIDE(DecDCTvlc2 = 0x8006F738);
PROVIDE(DecDCTvlcBuild = 0x8006FA98);
